## custompackages/package/atbm_wifi/Config.in
```kconfig
config BR2_PACKAGE_ATBM_WIFI
	bool "atbm_wifi"
	depends on BR2_LINUX_KERNEL
	help
	  This module allows you to create "ATBM WiFi module".
	  https://github.com/OpenIPC/atbm_60xx.git

comment "atbm wifi needs a Linux kernel to be built"
	depends on !BR2_LINUX_KERNEL
```

## custompackages/package/libtinyalsa/Config.in
```kconfig
config BR2_PACKAGE_LIBTINYALSA
	bool "libtinyalsa"
	help
	  Tiny library to interface with ALSA in the Linux kernel
	  https://github.com/tinyalsa/tinyalsa
```

## custompackages/package/onvif_srvd/Config.in
```kconfig
config BR2_PACKAGE_ONVIF_SRVD
    bool "onvif_srvd"
    help
      ONVIF Device(IP camera) Service server (Linux daemon)
      This server (Service) has a minimal implementation. Use this server as a template for writing your ONVIF service for an IP camera.
```

## custompackages/package/wsdd/Config.in
```kconfig
config BR2_PACKAGE_WSDD
    bool "wsdd"
    help
      wsdd is Linux daemon for ONVIF WS-Discovery service (server side).
```

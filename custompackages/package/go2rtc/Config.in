## custompackages/package/go2rtc/Config.in
```kconfig
config BR2_PACKAGE_GO2RTC
	bool "go2rtc streamer"
	help
	  Ultimate camera streaming application with support of RTSP, WebRTC, HomeKit, FFmpeg, RTMP, etc.
	  Note: Binary is not UPX compressed (~16mb, ~5mb in the gzip squashfs)
	  https://github.com/AlexxIT/go2rtc
```

## custompackages/package/onvif_simple_server/Config.in
```kconfig
config BR2_PACKAGE_ONVIF_SIMPLE_SERVER
	bool "onvif_simple_server"
	select BR2_PACKAGE_JSON_C
	select BR2_PACKAGE_MBEDTLS
	select BR2_PACKAGE_ZLIB
	help
	  Lightweight ONVIF Profile S/T server for resource-constrained
	  devices. It provides ONVIF SOAP services as CGI binaries and a
	  small WS-Discovery daemon.
```
